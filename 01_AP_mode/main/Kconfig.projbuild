## 01_AP_mode/main/Kconfig.projbuild
```kconfig
menu "Example Configuration"

    config ESP_WIFI_SSID
        string "WiFi SSID"
        default "myssid"
        help
            SSID (network name) for the example to connect to.

    config ESP_WIFI_PASSWORD
        string "WiFi Password"
        default "mypassword"
        help
            WiFi password (WPA or WPA2) for the example to use.
    config ESP_WIFI_CHANNEL
        int "WiFi Channel"
        range 1 13
        default 1
        help
            WiFi channel (network channel) for the example to use.

    config ESP_MAX_STA_CONN
        int "Maximal STA connections"
        default 4
        help
            Max number of the STA connects to AP.

    config CONFIG_EXAMPLE_IPV4
        int "Maximal STA connections"
        default 1
        help
            Max number of the STA connects to AP.

    config CONFIG_EXAMPLE_PORT
        int "Maximal STA connections"
        default 3333
        help
            PORT to connect

endmenu
```

## connectivity/components/station/Kconfig.projbuild
```kconfig
menu "Station Configuration"

    config EXAMPLE_SCAN_LIST_SIZE
        int "Max size of scan list"
        range 0 20
        default 10
        help
            The size of array that will be used to retrieve the list of access points.
    
    config WIFI_PREFIX_SSID
        string "Prefix for SSID"
        default "myssid"
        help
            The prefix that will be used to generate the SSID of the access point.
    
endmenu
```

## connectivity/main/Kconfig.projbuild
```kconfig
menu "ESP Node Configuration"

    config DEVICE_IS_ROOT_NODE
        int "Is root node"
        default 0
        help
            Boolean indicating if the ESP is the root node. 0: False, 1: True

    config DEVICE_INITIAL_MODE
        int "Initial mode"
        default 0
        help
            Initial mode of the ESP. 0: Station, 1: Access Point, 2: Both

    config DEVICE_ORIENTATION
        int "Device orientation"
        default 0
        help
            Orientation of the device. 0: North, 1: South, 2: East, 3: West

    config DEVICE_UUID
        string "Device UUID"
        default "0000-0000"
        help
            UUID of the device

    config DEVICE_WIFI_NETWORK_PREFIX
        string "WiFi network prefix"
        default "ESP"
        help
            Prefix of the WiFi network


    config DEVICE_WIFI_NETWORK_PASSWORD
        string "Password of the network"
        default "password"
        help
            Password of the network
    
    config SOFTAP_CHANNEL_TO_EMIT
        int "SoftAP channel to emit"
        default 1
        help
            SoftAP channel to emit
    
    config SOFTAP_MAX_STA_CONNECTIONS
        int "SoftAP max STA connections"
        default 1
        help
            SoftAP max STA connections
endmenu
```
